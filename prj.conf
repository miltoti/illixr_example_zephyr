## CMakeLists.txt
```
cmake_minimum_required(VERSION 3.20.0)

find_package(Zephyr REQUIRED HINTS $ENV{ZEPHYR_BASE})
project(illixr_working)

# ============================================================
# === Global toolchain / cross-compile settings (for OpenCV) ==
# ============================================================

# Make OpenCV's try_compile not attempt to run executables
set(CMAKE_TRY_COMPILE_TARGET_TYPE STATIC_LIBRARY CACHE STRING "" FORCE)

# ============================================================
# === Top-level path anchors ================================
# ============================================================

# Zephyr repo root (…/zephyr_ws/zephyr) is in ZEPHYR_BASE.
# Define a stable workspace top one level above it.
get_filename_component(ZEPHYR_TOP "${ZEPHYR_BASE}" DIRECTORY)

# This Zephyr variable is the root of your application (illixr_working).
# (Zephyr sets it; we fall back safely if needed.)
if(NOT DEFINED APPLICATION_SOURCE_DIR)
  set(APPLICATION_SOURCE_DIR "${CMAKE_CURRENT_SOURCE_DIR}")
endif()

message(STATUS "ZEPHYR_BASE            = ${ZEPHYR_BASE}")
message(STATUS "ZEPHYR_TOP             = ${ZEPHYR_TOP}")
message(STATUS "APPLICATION_SOURCE_DIR = ${APPLICATION_SOURCE_DIR}")

# Convenience: absolute path to your helper directory
set(ILLIXR_HELPER_DIR "${APPLICATION_SOURCE_DIR}/src/helper")



# OpenCV's "bitness" detection often fails under Zephyr cross builds
if(NOT DEFINED CMAKE_SIZEOF_VOID_P)
  set(CMAKE_SIZEOF_VOID_P 8 CACHE STRING "Pointer size" FORCE)
endif()

set(CMAKE_CXX_STANDARD 17)
set(CMAKE_CXX_STANDARD_REQUIRED ON)

# ============================================================
# === RISC-V flags (apply to EVERYTHING: app + plugins + OpenCV)
# ============================================================

set(RV64_FLAGS -march=rv64imafdc_zicsr_zifencei -mabi=lp64d)

# Apply globally so subprojects (OpenCV) inherit them
add_compile_options(${RV64_FLAGS})
add_link_options(${RV64_FLAGS})

# ============================================================
# === OpenCV: build from source once at top-level ============
# ============================================================

# Path to OpenCV source
set(OPENCV_SRC_DIR ${CMAKE_CURRENT_SOURCE_DIR}/../../third-party/opencv)

# If your OpenCV needs linker script fragments, apply at top-level (final link)
zephyr_linker_sources(SECTIONS
  ${CMAKE_CURRENT_SOURCE_DIR}/plugins/opencv/src/custom.ld
)

# OpenCV build options (static + minimal; matches your working cmake)
set(BUILD_opencv_apps OFF CACHE BOOL "" FORCE)
set(BUILD_opencv_version OFF CACHE BOOL "" FORCE)
set(OPENCV_BUILD_APP_LIST "" CACHE STRING "" FORCE)
set(BUILD_SHARED_LIBS OFF CACHE BOOL "" FORCE)
set(BUILD_opencv_world OFF CACHE BOOL "" FORCE)

option(OPENCV_BUILD_HIGHGUI "Enable building opencv_highgui module (desktop only)" OFF)
set(OPENCV_DEFAULT_BUILD_LIST "core,imgproc,imgcodecs")

if(OPENCV_BUILD_HIGHGUI)
  set(BUILD_LIST "${OPENCV_DEFAULT_BUILD_LIST},highgui" CACHE STRING "" FORCE)
  set(BUILD_opencv_highgui ON CACHE BOOL "" FORCE)
else()
  set(BUILD_LIST "${OPENCV_DEFAULT_BUILD_LIST}" CACHE STRING "" FORCE)
  set(BUILD_opencv_highgui OFF CACHE BOOL "" FORCE)
endif()

set(BUILD_TESTS OFF CACHE BOOL "" FORCE)
set(BUILD_PERF_TESTS OFF CACHE BOOL "" FORCE)
set(BUILD_EXAMPLES OFF CACHE BOOL "" FORCE)
set(BUILD_DOCS OFF CACHE BOOL "" FORCE)

set(WITH_TIFF OFF CACHE BOOL "" FORCE)
set(BUILD_TIFF OFF CACHE BOOL "" FORCE)
set(WITH_OPENEXR OFF CACHE BOOL "" FORCE)
set(WITH_JASPER OFF CACHE BOOL "" FORCE)
set(WITH_ADE OFF CACHE BOOL "" FORCE)
set(BUILD_ADE OFF CACHE BOOL "" FORCE)

set(OPENCV_FORCE_3RDPARTY_BUILD ON CACHE BOOL "" FORCE)
set(BUILD_ZLIB ON CACHE BOOL "" FORCE)
set(BUILD_PNG ON CACHE BOOL "" FORCE)
set(BUILD_JPEG ON CACHE BOOL "" FORCE)
set(WITH_OPENJPEG OFF CACHE BOOL "" FORCE)
set(BUILD_OPENJPEG OFF CACHE BOOL "" FORCE)

# Bare-metal: no pthread support
set(OPENCV_DISABLE_THREAD_SUPPORT ON CACHE BOOL "" FORCE)
set(WITH_PTHREADS_PF OFF CACHE BOOL "" FORCE)
set(OPENCV_DISABLE_PTHREADS_PF ON CACHE BOOL "" FORCE)

# IMPORTANT:
# Keep these as GLOBAL compile definitions so OpenCV subproject sees them
add_compile_definitions(
  OPENCV_DISABLE_THREAD_SUPPORT
  OPENCV_DISABLE_PTHREADS_PF
  M_PI=3.14159265358979323846
  M_E=2.71828182845904523536
)

# Build OpenCV in the main build tree
add_subdirectory(${OPENCV_SRC_DIR} ${CMAKE_CURRENT_BINARY_DIR}/opencv_build)

# ============================================================
# === OpenCV support shim (compile ONCE) =====================
# ============================================================

# atomic_shim.c provides missing atomics / builtins for OpenCV under Zephyr.
# Compile it once to avoid multiple-definition problems.
add_library(illixr_opencv_support STATIC
  ${CMAKE_CURRENT_SOURCE_DIR}/plugins/opencv/src/atomic_shim.c
  ${CMAKE_CURRENT_SOURCE_DIR}/plugins/opencv/src/libatomic_exchange_1_shim.c
)

target_link_libraries(illixr_opencv_support PRIVATE zephyr_interface)

# ============================================================
# === OpenCV bundle target used by app + plugins =============
# ============================================================

add_library(illixr_opencv INTERFACE)

# Anything linking illixr_opencv gets these include dirs and libs
set(OPENCV_BIN_DIR ${CMAKE_CURRENT_BINARY_DIR}/opencv_build)

target_include_directories(illixr_opencv INTERFACE
  ${OPENCV_BIN_DIR}/include          # <--- THIS is the big missing one
  ${CMAKE_CURRENT_BINARY_DIR}        # <--- covers build/opencv2 (seen in your tree)
  ${OPENCV_SRC_DIR}/modules/core/include
  ${OPENCV_SRC_DIR}/modules/imgproc/include
  ${OPENCV_SRC_DIR}/modules/imgcodecs/include
)

target_link_libraries(illixr_opencv INTERFACE
  -Wl,--start-group
  opencv_core
  opencv_imgproc
  opencv_imgcodecs
  illixr_opencv_support
  -Wl,--end-group
)

if(OPENCV_BUILD_HIGHGUI)
  target_link_libraries(illixr_opencv INTERFACE opencv_highgui)
endif()

# Make OpenCV available to non-plugin app code too
target_link_libraries(app PRIVATE illixr_opencv)

# ============================================================
# === YAML CONFIG PARSING ====================================
# ============================================================

if (NOT DEFINED YAML_FILE)
  message(FATAL_ERROR "You must pass: -DYAML_FILE=<path_to_yaml>")
endif()

get_filename_component(YAML_FILE "${YAML_FILE}" ABSOLUTE)
message(STATUS "Using YAML_FILE: ${YAML_FILE}")

set(READ_YAML_SCRIPT "${CMAKE_CURRENT_SOURCE_DIR}/read_yaml.py")
set(GENERATED_CONFIG "${CMAKE_CURRENT_BINARY_DIR}/generated_config.hpp")

add_custom_command(
  OUTPUT ${GENERATED_CONFIG}
  COMMAND ${Python3_EXECUTABLE} ${READ_YAML_SCRIPT} ${YAML_FILE} ${GENERATED_CONFIG}
  DEPENDS ${READ_YAML_SCRIPT} ${YAML_FILE}
  COMMENT "Parsing YAML and generating ${GENERATED_CONFIG}"
)

add_custom_target(generate_yaml ALL DEPENDS ${GENERATED_CONFIG})
target_include_directories(app PRIVATE ${CMAKE_CURRENT_BINARY_DIR})

# ============================================================
# === CORE SOURCE FILES ======================================
# ============================================================

target_sources(app PRIVATE
  src/main.cpp
  src/node.cpp
  src/relative_clock.cpp
  src/phonebook_new.cpp
  src/stoplight.cpp
  data/V1_02_medium/mav0/imu0/data.csv
)

# ============================================================
# === Restore Zephyr output paths (OpenCV can mess with them) =
# ============================================================

set_target_properties(zephyr_final PROPERTIES
  RUNTIME_OUTPUT_DIRECTORY "${CMAKE_BINARY_DIR}/zephyr"
  OUTPUT_NAME "zephyr"
)

if(TARGET zephyr_prebuilt)
  set_target_properties(zephyr_prebuilt PROPERTIES
    RUNTIME_OUTPUT_DIRECTORY "${CMAKE_BINARY_DIR}/zephyr"
  )
endif()

# Ensure Zephyr post-build scripts look for zephyr/zephyr.elf
set(KERNEL_ELF_NAME zephyr.elf CACHE INTERNAL "" FORCE)


# ============================================================
# === READ YAML AND LOAD PLUGIN NAMES ========================
# ============================================================

file(READ "${YAML_FILE}" YAML_CONTENTS)
string(REGEX MATCH "plugins:[ \t]*([^\n\r]+)" PLUGIN_LINE "${YAML_CONTENTS}")

if(PLUGIN_LINE)
  string(REGEX REPLACE "plugins:[ \t]*" "" PLUGIN_LIST_RAW "${PLUGIN_LINE}")
  string(REPLACE "," ";" PLUGIN_NAMES "${PLUGIN_LIST_RAW}")

  set(PLUGIN_NAMES_CLEAN "")
  foreach(P IN LISTS PLUGIN_NAMES)
    string(STRIP "${P}" P_STRIPPED)
    if(P_STRIPPED)
      list(APPEND PLUGIN_NAMES_CLEAN "${P_STRIPPED}")
    endif()
  endforeach()

  message(STATUS "Resolved plugins: ${PLUGIN_NAMES_CLEAN}")

  foreach(P IN LISTS PLUGIN_NAMES_CLEAN)
    set(PLUGIN_DIR "${CMAKE_CURRENT_SOURCE_DIR}/plugins/${P}")
    message(STATUS "Adding plugin '${P}' from ${PLUGIN_DIR}")

    add_subdirectory("${PLUGIN_DIR}" "${CMAKE_CURRENT_BINARY_DIR}/plugins/${P}")

    if(TARGET ${P})
      target_sources(app PRIVATE $<TARGET_OBJECTS:${P}>)
      message(STATUS "Added plugin '${P}' object files into app")
    else()
      message(WARNING "Plugin '${P}' did not define target '${P}'")
    endif()
  endforeach()
endif()
```

## prj.conf
```kconfig
# ---------------------------------------------------------
# 1. Libc & C++ (The OpenCV Essentials)
# ---------------------------------------------------------
CONFIG_NEWLIB_LIBC=y
CONFIG_NEWLIB_LIBC_NANO=n
CONFIG_PICOLIBC=n
CONFIG_REQUIRES_FULL_LIBCPP=y

CONFIG_CPP=y
CONFIG_STD_CPP20=y
CONFIG_GLIBCXX_LIBCPP=y
CONFIG_CPP_EXCEPTIONS=y
CONFIG_CPP_RTTI=y
CONFIG_GNU_C_EXTENSIONS=y

# ---------------------------------------------------------
# 2. Memory Management (Critical Fixes)
# ---------------------------------------------------------
CONFIG_HEAP_MEM_POOL_SIZE=1048576 
CONFIG_COMMON_LIBC_MALLOC=y
# Keep this large enough for OpenCV, but watch for the PLIC trap
CONFIG_COMMON_LIBC_MALLOC_ARENA_SIZE=67108864

# DANGEROUS: Disable this to avoid the trap_store_access_fault
# Your hardware lacks the MMU/PMP support for mapped stacks
CONFIG_THREAD_STACK_MEM_MAPPED=n

# ---------------------------------------------------------
# 3. POSIX & Threading (DO NOT REMOVE)
# ---------------------------------------------------------
CONFIG_POSIX_API=y
CONFIG_POSIX_THREADS=y
CONFIG_MULTITHREADING=y
CONFIG_DYNAMIC_THREAD=y
CONFIG_DYNAMIC_THREAD_ALLOC=y

# ---------------------------------------------------------
# 4. Hardware & Debug
# ---------------------------------------------------------
CONFIG_FPU=y
# chanege to 2 --> export binary to run on firesim
CONFIG_MP_MAX_NUM_CPUS=4
CONFIG_MAIN_STACK_SIZE=1048576
CONFIG_LOG=y
```

## src/main.cpp
```c
#include <zephyr/kernel.h>
#include <stdio.h>
#include <stdint.h> // For uint64_t
#include "phonebook_new.hpp"
#include "runtime.hpp"

extern "C" {
    extern volatile uint64_t tohost;
    extern volatile uint64_t fromhost;
}

void firesim_exit(int code) {
    // This will now use the same 'tohost' variable that the UART driver uses
    tohost = (uint64_t)((code << 1) | 1);
    while (1); 
}
// --------------------------

uint64_t g_program_start_mtime = 0;

int main() {
    printf("========== ILLIXR Static Runtime (Zephyr) ==========\n");

    ILLIXR::init_phonebook_global();
    auto& pb = ILLIXR::get_phonebook();
    ILLIXR::Runtime runtime(pb);

    const char* data_path      = "../data/V1_02_medium/mav0";
    const char* demo_data_path = "../demo_data";

    runtime.initialize(data_path, demo_data_path);
    runtime.start_all_plugins();
    // INcluding the runtime thread itself timing. Need better way to figure out runtime whole time
    k_sleep(K_SECONDS(500000));

    runtime.shutdown();

    printf("========== Runtime Complete ==========\n");
    
    // Final step: Signal FireSim to terminate
    firesim_exit(0); 

    return 0;
}
```

## src/data_format.hpp
```c
#include <relative_clock.hpp>
#include <Eigen/Dense>
// in ../../src/data_format.hpp (approx)
namespace ILLIXR {
    using ullong = unsigned long long;

    struct ImuMsg {
        time_point      time;
        Eigen::Vector3d angular_v;
        Eigen::Vector3d linear_a;
    };
    struct PoseMsg {
        time_point timestamp;
        Eigen::Vector3f position;        // [x, y, z] meters
        Eigen::Quaternionf orientation;  // (w, x, y, z)
    };
    struct ImuParams {
        double gyro_noise;           // Gyro white noise
        double acc_noise;            // Accel white noise
        double gyro_walk;            // Gyro bias random walk
        double acc_walk;             // Accel bias random walk
        Eigen::Vector3d n_gravity;   // Gravity vector
        double imu_integration_sigma;
        double nominal_rate;
    };
    struct ImuIntegratorInput {
        time_point timestamp;
        duration cam_imu_offset;
        ImuParams params;
        Eigen::Vector3d bias_accel;    // Current biases
        Eigen::Vector3d bias_gyro;
        Eigen::Vector3d position;      // Current full state
        Eigen::Vector3d velocity;
        Eigen::Quaterniond orientation;
    };

}
```

## src/data_format_opencv.hpp
```c
#include <relative_clock.hpp>
#include <Eigen/Dense>
// in ../../src/data_format.hpp (approx)
namespace ILLIXR {
    using ullong = unsigned long long;

    struct CamMsg {
        time_point      time;
        cv::Mat         img0;
        cv::Mat         img1;
    };

}
```

## src/node.cpp
```c
// node.cpp

#include "node.hpp"

namespace ILLIXR {

// ---------------------------
// Explicit initialization
// ---------------------------

void Node::initialize(phonebook_new& pb, const char* name) {
    pb_ = &pb;

    // Save name locally
    strncpy(name_, name, MAX_PLUGIN_NAME_LEN - 1);
    name_[MAX_PLUGIN_NAME_LEN - 1] = '\0';

    // NOTE: registration with phonebook is done elsewhere (Plugin wrapper).
}

// ---------------------------
// Periodic service
// ---------------------------

void Node::service_periodic() {
    if (!pb_) { return; }

    uint64_t now_ms = k_uptime_get();
    for (auto& job : periodic_jobs_) {
        job->tick(now_ms);
    }
}

// ---------------------------
// start() is virtual and has
// no base implementation.
// ---------------------------

} // namespace ILLIXR
```

## src/node.hpp
```c
#ifndef ILLIXR_NODE_HPP
#define ILLIXR_NODE_HPP

#include "phonebook_new.hpp"

#include <stdint.h>
#include <stddef.h>
#include <string.h>
#include <vector>
#include <memory>
#include <zephyr/kernel.h> // for k_uptime_get

namespace ILLIXR {

constexpr size_t MAX_PLUGIN_NAME_LEN = 32;

/**
 * RTOS-safe Node
 *
 * IMPORTANT:
 * - Registration is handled by the Plugin wrapper.
 * - Periodic publishing does NOT create extra threads.
 * Plugins must call Node::service_periodic() from their own thread loop.
 */
class Node {
public:
    typedef void (*MsgCallbackFn)(void* context, const void* msg);

    Node() : pb_{nullptr} {
        name_[0] = '\0';
    }

    explicit Node(const char* name) : pb_{nullptr} {
        strncpy(name_, name, MAX_PLUGIN_NAME_LEN - 1);
        name_[MAX_PLUGIN_NAME_LEN - 1] = '\0';
    }

    virtual ~Node() = default;

    void initialize(phonebook_new& pb, const char* name);

    // -----------------------------
    // Messaging utilities
    // -----------------------------
    template<typename MsgT>
    void subscribe_from(const char* sender_name,
                        void (*callback)(void* ctx, const MsgT&),
                        void* context) {
        if (!pb_) { return; }
        pb_->subscribe<MsgT>(sender_name, name_, callback, context);
    }

    template<typename MsgT>
    void publish_to(const char* receiver_name, const MsgT& msg) {
        if (!pb_) { return; }
        pb_->publish<MsgT>(name_, receiver_name, msg);
    }

    /**
     * Registers a periodic job.
     * DOES NOT create a thread. The plugin's thread must call service_periodic().
     */
    template<typename MsgT, typename MsgGenerator>
    void publish_to_periodic(const char* receiver_name,
                             uint32_t interval_ms,
                             MsgGenerator generator) {
        if (!pb_) { return; }

        using JobT = PeriodicJob<MsgT, MsgGenerator>;
        auto job   = std::make_unique<JobT>(
            pb_,
            name_,
            receiver_name,
            interval_ms,
            generator
        );
        periodic_jobs_.push_back(std::move(job));
    }

    /**
     * Drives the periodic jobs. Call this in your plugin's while(1) loop.
     */
    void service_periodic();

    const char* name() const { return name_; }
    using ShutdownCallback = void (*)(void*);

        void set_shutdown_callback(ShutdownCallback cb, void* ctx) {
            shutdown_cb_  = cb;
            shutdown_ctx_ = ctx;
        }

        void shutdown() {
            if (shutdown_cb_) {
                shutdown_cb_(shutdown_ctx_);
            }
        }
private:
    // Base class for polymorphic storage of templated jobs
    struct PeriodicJobBase {
        virtual ~PeriodicJobBase() = default;
        virtual void tick(uint64_t now_ms) = 0;
    };

    template<typename MsgT, typename Generator>
    struct PeriodicJob : PeriodicJobBase {
        phonebook_new* pb;
        char           sender[MAX_PLUGIN_NAME_LEN];
        char           receiver[MAX_PLUGIN_NAME_LEN];
        Generator      gen;
        uint32_t       interval_ms;
        uint64_t       next_fire_ms;

        PeriodicJob(phonebook_new* pb_,
                    const char* sender_name,
                    const char* receiver_name,
                    uint32_t interval,
                    Generator g)
            : pb{pb_}
            , gen{g}
            , interval_ms{interval}
            , next_fire_ms{k_uptime_get() + interval}
        {
            strncpy(sender,   sender_name,   MAX_PLUGIN_NAME_LEN - 1);
            sender[MAX_PLUGIN_NAME_LEN - 1] = '\0';

            strncpy(receiver, receiver_name, MAX_PLUGIN_NAME_LEN - 1);
            receiver[MAX_PLUGIN_NAME_LEN - 1] = '\0';
        }

        void tick(uint64_t now_ms) override {
            if (!pb) { return; }
            if (now_ms >= next_fire_ms) {
                MsgT msg = gen();
                pb->template publish<MsgT>(sender, receiver, msg);
                next_fire_ms = now_ms + interval_ms;
            }
        }
    };

    phonebook_new* pb_;
    char           name_[MAX_PLUGIN_NAME_LEN];
    std::vector<std::unique_ptr<PeriodicJobBase>> periodic_jobs_;
    ShutdownCallback shutdown_cb_;
    void* shutdown_ctx_;};

} // namespace ILLIXR

#endif // ILLIXR_NODE_HPP
```

## src/phonebook_new.cpp
```c
#include "phonebook_new.hpp"
#include <new>
#include <cstdio>
namespace ILLIXR {

// Allocate raw storage for the phonebook instance
static uint8_t pb_storage[sizeof(phonebook_new)]
    __attribute__((aligned(alignof(phonebook_new))));

static phonebook_new* pb_ptr = nullptr;

void init_phonebook_global() {
    if (pb_ptr == nullptr) {
        printf("[phonebook] init_phonebook_global(): constructing phonebook at %p\n",
               (void*)pb_storage);

        pb_ptr = new (pb_storage) phonebook_new();

        printf("[phonebook] init_phonebook_global(): pb_ptr = %p\n", (void*)pb_ptr);
    }
}

phonebook_new& get_phonebook() {
    printf("[phonebook] get_phonebook() called\n");
    printf("  pb_ptr = %p\n", (void*)pb_ptr);

    if (pb_ptr == nullptr) {
        printf("[phonebook] ERROR: pb_ptr is NULL! Calling init_phonebook_global() implicitly.\n");
        init_phonebook_global();
    }

    return *pb_ptr;
}

} // namespace ILLIXR
```

## src/phonebook_new.hpp
```c
#ifndef ILLIXR_PHONEBOOK_NEW_HPP
#define ILLIXR_PHONEBOOK_NEW_HPP

#include <zephyr/kernel.h>
#include <stdint.h>
#include <stddef.h>
#include <string.h>
#include <cstdio>

namespace ILLIXR {

class Node;

constexpr size_t MAX_PLUGINS                 = 10;
constexpr size_t MAX_CHANNELS                = 20;
constexpr size_t MAX_SUBSCRIBERS_PER_CHANNEL = 4;

class phonebook_new {
public:
    struct Entry {
        const char* name;
        Node*       instance;
    };

    phonebook_new() : count_(0), channel_count_(0) {
        k_mutex_init(&mutex_);
    }

    bool register_plugin(const char* name, Node* instance) {
        printf("Registering plugin: %s\n", name);
        k_mutex_lock(&mutex_, K_FOREVER);
        if (count_ >= MAX_PLUGINS) {
            k_mutex_unlock(&mutex_);
            return false;
        }
        entries_[count_++] = {name, instance};
        k_mutex_unlock(&mutex_);
        return true;
    }

    Node* lookup(const char* name) {
        k_mutex_lock(&mutex_, K_FOREVER);
        for (size_t i = 0; i < count_; i++) {
            if (strcmp(name, entries_[i].name) == 0) {
                Node* node = entries_[i].instance;
                k_mutex_unlock(&mutex_);
                return node;
            }
        }
        k_mutex_unlock(&mutex_);
        return nullptr;
    }

    Entry*       begin()       { return entries_; }
    Entry*       end()         { return entries_ + count_; }
    const Entry* begin() const { return entries_; }
    const Entry* end()   const { return entries_ + count_; }
    size_t       size()  const { return count_; }

    // =========================================================================
    // MESSAGING
    // =========================================================================

    struct Subscriber {
        void*  context;
        void (*callback)(void*, const void*);
        uintptr_t type_id;
    };

    struct Channel {
        const char* sender;
        const char* receiver;
        Subscriber  subs[MAX_SUBSCRIBERS_PER_CHANNEL];
        size_t      sub_count = 0;
    };

    template<typename MsgT>
    static uintptr_t type_id() {
        static char id;
        return (uintptr_t)&id;
    }

    template<typename MsgT>
    void subscribe(const char* sender,
                   const char* receiver,
                   void (*cb)(void*, const MsgT&),
                   void* ctx)
    {
        k_mutex_lock(&mutex_, K_FOREVER);
        Channel* ch = find_or_create_channel(sender, receiver);
        if (!ch || ch->sub_count >= MAX_SUBSCRIBERS_PER_CHANNEL) {
            k_mutex_unlock(&mutex_);
            return;
        }
        Subscriber& s = ch->subs[ch->sub_count++];
        s.context  = ctx;
        s.callback = reinterpret_cast<void (*)(void*, const void*)>(cb);
        s.type_id  = type_id<MsgT>();
        k_mutex_unlock(&mutex_);
    }

    // -------------------------------------------------------------------------
    // publish<MsgT>
    //
    // CRITICAL FIX: We must NOT hold mutex_ while invoking callbacks.
    //
    // Reason: callbacks may themselves call publish() (e.g. openvins publishes
    // PoseMsg and ImuIntegratorInput inside its camera callback). Calling
    // publish() while holding a non-recursive mutex causes an immediate deadlock.
    //
    // Fix: snapshot the matching subscribers under the lock, release the lock,
    // then invoke each callback outside the lock.
    //
    // This is safe because:
    //   • Subscribers are only added (never removed at runtime).
    //   • The snapshot is a plain struct copy — no heap allocation needed.
    //   • Callbacks run with stale-at-worst subscriber data, which is fine
    //     since the subscriber list is stable after plugin construction.
    // -------------------------------------------------------------------------
    template<typename MsgT>
    void publish(const char* sender,
                 const char* receiver,
                 const MsgT& msg)
    {
        // --- 1. Snapshot subscribers under lock ------------------------------
        Subscriber snapshot[MAX_SUBSCRIBERS_PER_CHANNEL];
        size_t     snap_count = 0;
        uintptr_t  tid        = type_id<MsgT>();

        k_mutex_lock(&mutex_, K_FOREVER);
        Channel* ch = find_channel(sender, receiver);
        if (ch) {
            for (size_t i = 0; i < ch->sub_count; i++) {
                if (ch->subs[i].type_id == tid) {
                    snapshot[snap_count++] = ch->subs[i];
                }
            }
        }
        k_mutex_unlock(&mutex_);   // ← released BEFORE any callback fires

        // --- 2. Invoke callbacks outside lock --------------------------------
        for (size_t i = 0; i < snap_count; i++) {
            auto cb = reinterpret_cast<void (*)(void*, const MsgT&)>(
                          snapshot[i].callback);
            cb(snapshot[i].context, msg);
        }
    }

private:
    k_mutex mutex_;
    Entry   entries_[MAX_PLUGINS];
    size_t  count_;

    Channel channels_[MAX_CHANNELS];
    size_t  channel_count_;

    Channel* find_channel(const char* sender, const char* receiver) {
        for (size_t i = 0; i < channel_count_; i++) {
            if (!strcmp(channels_[i].sender,   sender) &&
                !strcmp(channels_[i].receiver, receiver)) {
                return &channels_[i];
            }
        }
        return nullptr;
    }

    Channel* find_or_create_channel(const char* sender, const char* receiver) {
        Channel* ch = find_channel(sender, receiver);
        if (ch) return ch;
        if (channel_count_ >= MAX_CHANNELS) return nullptr;

        Channel& new_ch    = channels_[channel_count_++];
        new_ch.sender      = sender;
        new_ch.receiver    = receiver;
        new_ch.sub_count   = 0;
        return &new_ch;
    }
};

phonebook_new& get_phonebook();
void           init_phonebook_global();

} // namespace ILLIXR

#endif // ILLIXR_PHONEBOOK_NEW_HPP
```

## src/plugin.hpp
```c
#pragma once

#include "node.hpp"
#include "phonebook_new.hpp"
#include <zephyr/kernel.h>

namespace ILLIXR {

/**
 * Active Object Plugin base:
 * - Owns a Node.
 * - Derived class MUST create its own Zephyr thread in start().
 */
class Plugin {
public:
    Plugin(phonebook_new& pb, const char* name)
        : node_{}
        , should_stop_{false} {
        // 1. Initialize Node's internal state
        node_.initialize(pb, name);

        // 2. Register the Node instance with the phonebook
        pb.register_plugin(name, &node_);
    }

    virtual ~Plugin() = default;

    /**
     * Start the plugin worker thread.
     * MUST return immediately (non-blocking).
     * Implementation should call k_thread_create using a stack defined in the derived class.
     */
    virtual void start() = 0;

    /**
     * Stop the plugin worker thread (optional).
     */
    virtual void stop() {
        should_stop_ = true;
    }

    // Access to the underlying Node
    Node&       node()       { return node_; }
    const Node& node() const { return node_; }

protected:
    Node node_;
    volatile bool should_stop_;

    /**
     * Helper for the threaded loop.
     * The derived class's thread entry point should call this.
     *
     * @param sleep_ms - The cycle tick rate (prevents CPU starvation).
     */
    void run_loop(uint32_t sleep_ms = 10) {
        while (!should_stop_) {
            // 1. Check and fire any periodic jobs registered in the Node
            node_.service_periodic();

            // 2. Yield/Sleep to allow other threads to run
            k_msleep(sleep_ms);
        }
    }
};

} // namespace ILLIXR
```

## src/plugin_registry.hpp
```c
#ifndef ILLIXR_PLUGIN_REGISTRY_HPP
#define ILLIXR_PLUGIN_REGISTRY_HPP

#include <stddef.h>
#include <stdint.h>
#include <stdio.h>
#include "phonebook_new.hpp"

namespace ILLIXR {

using plugin_start_fn_t = void (*)(phonebook_new&);

constexpr size_t MAX_REGISTERED_PLUGINS = 20;

struct plugin_registry_entry {
    const char*        name;
    plugin_start_fn_t  start_fn;
};

class PluginRegistry {
public:
    PluginRegistry() : count_{0} {
        printf("[registry] PluginRegistry constructed @%p\n", (void*)this);
    }

    bool register_plugin(const char* name, plugin_start_fn_t fn) {
        printf("[registry] Registering plugin '%s' (current count=%zu)\n",
               name, count_);

        if (count_ >= MAX_REGISTERED_PLUGINS) {
            printf("[registry] ERROR: MAX_REGISTERED_PLUGINS reached!\n");
            return false;
        }

        entries_[count_].name     = name;
        entries_[count_].start_fn = fn;
        ++count_;

        printf("[registry] DONE registering '%s' → new count=%zu\n",
               name, count_);
        return true;
    }

    size_t size() const { return count_; }

    const plugin_registry_entry* begin() const { return entries_; }
    const plugin_registry_entry* end()   const { return entries_ + count_; }

private:
    plugin_registry_entry entries_[MAX_REGISTERED_PLUGINS];
    size_t count_;
};

inline PluginRegistry& get_plugin_registry() {
    printf("[registry] get_plugin_registry() called\n");
    static PluginRegistry registry;
    return registry;
}

// ===========================================================================
// UPDATED REGISTER_PLUGIN macro with HEAVY DEBUGGING
// Shows:
//   • file + line where macro expands
//   • static constructor address
//   • proof the static object exists (prints its address)
//   • proof the ctor runs BEFORE runtime
// ===========================================================================
#define REGISTER_PLUGIN(name)                                                      \
    extern void start_##name(::ILLIXR::phonebook_new& pb);                         \
    namespace {                                                                    \
    struct plugin_registrar_##name {                                               \
        plugin_registrar_##name() {                                                \
            printf("[registry] STATIC CTOR FIRED for %s\n", #name);                \
            printf("[registry]   from file: %s:%d\n", __FILE__, __LINE__);         \
            printf("[registry]   ctor this=%p\n", (void*)this);                    \
            ::ILLIXR::get_plugin_registry().register_plugin(                       \
                #name, &start_##name);                                             \
        }                                                                          \
    };                                                                             \
    static plugin_registrar_##name registrar_instance_##name                       \
        __attribute__((used, retain));                                             \
    }

} // namespace ILLIXR

#endif // ILLIXR_PLUGIN_REGISTRY_HPP
```

## src/relative_clock.cpp
```c
#include "relative_clock.hpp"
#include <cstdio>

namespace ILLIXR {

RelativeClock& get_global_relative_clock() {
    static RelativeClock clock;
    return clock;
}

void RelativeClock::print() const {
    auto ns = now_ns();
    std::printf("relative_clock now: %lld ns since start\n",
                static_cast<long long>(ns));
}

} // namespace ILLIXR
```

## src/relative_clock.hpp
```c
#pragma once

#include <cassert>
#include <chrono>
#include <cstdint>
#include <ratio>
#include <zephyr/sys/atomic.h>   // Zephyr-native atomic — replaces std::atomic

namespace ILLIXR {

/**
 * Mimic of `std::chrono::time_point<Clock, Rep>`.
 */
using _clock_rep      = long;
using _clock_period   = std::nano;
using _clock_duration = std::chrono::duration<_clock_rep, _clock_period>;

class time_point {
public:
    using duration = _clock_duration;

    time_point() = default;

    constexpr explicit time_point(const duration& time_since_epoch)
        : _m_time_since_epoch{time_since_epoch} { }

    [[nodiscard]] duration time_since_epoch() const {
        return _m_time_since_epoch;
    }

    time_point& operator+=(const duration& d) {
        _m_time_since_epoch += d;
        return *this;
    }

    time_point& operator-=(const duration& d) {
        _m_time_since_epoch -= d;
        return *this;
    }

private:
    duration _m_time_since_epoch{};
};

inline time_point::duration operator-(const time_point& lhs, const time_point& rhs) {
    return lhs.time_since_epoch() - rhs.time_since_epoch();
}
inline time_point operator+(const time_point& pt, const time_point::duration& d) {
    return time_point{pt.time_since_epoch() + d};
}
inline time_point operator+(const time_point::duration& d, const time_point& pt) {
    return time_point{pt.time_since_epoch() + d};
}
inline bool operator<(const time_point& lhs, const time_point& rhs) {
    return lhs.time_since_epoch() < rhs.time_since_epoch();
}
inline bool operator>(const time_point& lhs, const time_point& rhs) {
    return lhs.time_since_epoch() > rhs.time_since_epoch();
}
inline bool operator<=(const time_point& lhs, const time_point& rhs) {
    return lhs.time_since_epoch() <= rhs.time_since_epoch();
}
inline bool operator>=(const time_point& lhs, const time_point& rhs) {
    return lhs.time_since_epoch() >= rhs.time_since_epoch();
}
inline bool operator==(const time_point& lhs, const time_point& rhs) {
    return lhs.time_since_epoch() == rhs.time_since_epoch();
}
inline bool operator!=(const time_point& lhs, const time_point& rhs) {
    return lhs.time_since_epoch() != rhs.time_since_epoch();
}

/**
 * @brief Relative clock for all of ILLIXR.
 */
class RelativeClock {
public:
    using rep      = _clock_rep;
    using period   = _clock_period;
    using duration = _clock_duration;
    using tp       = ILLIXR::time_point;

    static constexpr bool is_steady = true;
    static_assert(std::chrono::steady_clock::is_steady);

    RelativeClock() {
        atomic_set(&_dataset_origin_ns, (atomic_val_t)-1);
    }

    [[nodiscard]] tp now() const {
        assert(is_started() && "Cannot call now() before start()");
        auto delta = std::chrono::duration_cast<duration>(
            std::chrono::steady_clock::now() - _m_start);
        return tp{delta};
    }

    [[nodiscard]] std::int64_t now_ns() const {
        return static_cast<std::int64_t>(
            std::chrono::duration_cast<std::chrono::nanoseconds>(
                now().time_since_epoch()).count());
    }

    [[nodiscard]] std::int64_t absolute_ns(tp relative) const {
        auto base_ns = std::chrono::duration_cast<std::chrono::nanoseconds>(
                           _m_start.time_since_epoch()).count();
        auto offset_ns = std::chrono::duration_cast<std::chrono::nanoseconds>(
                             relative.time_since_epoch()).count();
        return static_cast<std::int64_t>(base_ns + offset_ns);
    }

    void start() {
        _m_start  = std::chrono::steady_clock::now();
        _started  = true;
    }

    [[nodiscard]] bool is_started() const { return _started; }

    [[nodiscard]] tp start_time() const {
        auto dur = std::chrono::duration_cast<duration>(_m_start.time_since_epoch());
        return tp{dur};
    }

    void print() const;

    // =========================================================================
    // Dataset time cursor
    // =========================================================================
    //
    // Plugins agree on a shared "dataset origin": the timestamp of the very
    // first sample in the dataset (set once by the first plugin to call
    // set_dataset_origin()).
    //
    // Any plugin can then call dataset_now_ns() to find out which dataset
    // timestamp corresponds to the current wall-clock instant:
    //
    //   dataset_now = dataset_origin + wall_elapsed_since_start
    //
    // This gives all plugins the SAME answer for "what time is it in the
    // dataset?", so they independently decide when to fire without racing.
    //
    // IMU fires at dataset_origin + 0, 5ms, 10ms, ...
    // Camera fires at dataset_origin + 50ms, 100ms, ...
    // Both just compare their next sample's timestamp to dataset_now_ns().
    // =========================================================================

    /**
     * @brief Set the dataset origin (ns). Call once with the timestamp of
     *        the very first sample across all sensors.
     *        Idempotent — only the first call takes effect (CAS on -1).
     */
    void set_dataset_origin(std::int64_t origin_ns) {
        // atomic_cas(ptr, expected, desired) — succeeds only when current == -1.
        // On rv64 atomic_val_t == intptr_t == int64_t, so the cast is safe.
        atomic_cas(&_dataset_origin_ns,
                   (atomic_val_t)-1,
                   (atomic_val_t)origin_ns);
    }

    /**
     * @brief Returns the current dataset timestamp in nanoseconds.
     *
     * dataset_now = dataset_origin + (wall_clock elapsed since start())
     *
     * Returns -1 if the clock hasn't been started or origin hasn't been set.
     */
    [[nodiscard]] std::int64_t dataset_now_ns() const {
        if (!_started) return -1;
        std::int64_t origin = (std::int64_t)atomic_get(&_dataset_origin_ns);
        if (origin < 0) return -1;
        return origin + now_ns();
    }

    /**
     * @brief Convenience: is a sample with this dataset timestamp due yet?
     */
    [[nodiscard]] bool is_due(std::int64_t sample_dataset_ns) const {
        std::int64_t now = dataset_now_ns();
        if (now < 0) return false;
        return now >= sample_dataset_ns;
    }

private:
    std::chrono::steady_clock::time_point _m_start{};
    bool                                  _started{false};

    // atomic_t is Zephyr's RTOS-native atomic integer.
    // On rv64, atomic_val_t == intptr_t == int64_t — exactly what we need.
    // mutable so const methods (dataset_now_ns, is_due) can call atomic_get.
    mutable atomic_t _dataset_origin_ns;
};

using duration = RelativeClock::duration;

template<typename unit = std::ratio<1>>
double duration2double(duration dur) {
    return std::chrono::duration<double, unit>{dur}.count();
}

constexpr duration freq2period(double fps) {
    return duration{
        static_cast<std::size_t>(
            std::chrono::nanoseconds{std::chrono::seconds{1}}.count() / fps)};
}

RelativeClock& get_global_relative_clock();

} // namespace ILLIXR
```

## src/runtime.cpp
```c
/*#ifndef ILLIXR_RUNTIME_HPP
#define ILLIXR_RUNTIME_HPP

#include <zephyr/kernel.h>
#include <stdio.h>

#include "phonebook_new.hpp"
#include "plugin_registry.hpp"

namespace ILLIXR {

class Runtime {
public:
    explicit Runtime(phonebook_new& pb) : pb_(pb) {}

    /**
     * @brief Initialize paths or global resources (optional)
     
    void initialize(const char* data_path, const char* demo_path) {
        printf("[runtime] Initialize called.\n");
        printf("[runtime]   Data Path: %s\n", data_path ? data_path : "NULL");
        printf("[runtime]   Demo Path: %s\n", demo_path ? demo_path : "NULL");
    }

    /**
     * @brief Iterates the registry and starts every plugin.
     * * Since plugins now manage their own threads (via k_thread_create in start()),
     * this function simply calls the factory function for each plugin and returns 
     * immediately. It does not block.
     
    void start_all_plugins() {
        printf("[runtime] Starting all plugins...\n");
        
        PluginRegistry& reg = get_plugin_registry();
        
        // Use range-based for loop (relies on PluginRegistry::begin()/end())
        for (const auto& entry : reg) {
            printf("[runtime] Launching plugin: %s\n", entry.name);
            
            // This calls the factory function (e.g., start_offline_imu),
            // which constructs the plugin and spawns its thread.
            entry.start_fn(pb_);
        }
        
        printf("[runtime] All plugins launched. Threads are running.\n");
    }

    /**
     * @brief Deprecated method kept for main.cpp compatibility.
     * In the threaded model, start_all_plugins() already sets everything running.
     
    void run_all_plugins() {
        // No-op: threads are already running.
    }

    /**
     * @brief Cleanup routine.
     
    void shutdown() {
        printf("[runtime] Shutting down...\n");
        // Logic to signal threads to stop would go here
    }

private:
    phonebook_new& pb_;
};

} // namespace ILLIXR

#endif
*/
```

## src/runtime.hpp
```c
#ifndef ILLIXR_RUNTIME_HPP
#define ILLIXR_RUNTIME_HPP

#include <zephyr/kernel.h>
#include <stdio.h>
#include <stdint.h>
#include "phonebook_new.hpp"
#include "plugin_registry.hpp"
#include "stoplight.hpp"   // extern declarations only — definitions are in stoplight.cpp

// Defined in main.cpp; recorded here at the moment data flow begins.
extern uint64_t g_program_start_mtime;

// CLINT mtime: global real-time counter shared across all harts.
// Address 0x200bff8 from the spike DTS. Safe to compare across CPUs.
static inline uint64_t read_mtime_runtime() {
    volatile uint64_t* mtime = reinterpret_cast<volatile uint64_t*>(0x200bff8UL);
    return *mtime;
}

namespace ILLIXR {

class Runtime {
public:
    explicit Runtime(phonebook_new& pb) : pb_(pb) {}

    void initialize(const char* data_path, const char* demo_path) {
        printf("[runtime] Initialize called.\n");
        printf("[runtime]   Data Path: %s\n", data_path ? data_path : "NULL");
        printf("[runtime]   Demo Path: %s\n", demo_path ? demo_path : "NULL");
    }

    void start_all_plugins() {
        printf("[runtime] Starting all plugins...\n");
        printf("[runtime] Thread: %p\n", k_current_get());

        PluginRegistry& reg = get_plugin_registry();

        // ── Step 1: spawn all plugin threads ─────────────────────────────
        // Order doesn't matter — we wait for all of them below before
        // any data starts flowing.
        for (const auto& entry : reg) {
            printf("[runtime] Launching plugin: %s\n", entry.name);
            entry.start_fn(pb_);
        }

        // ── Step 2: wait for every thread to finish _p_thread_setup() ────
        // Each plugin's threadloop::run() gives stoplight_ready once after
        // _p_thread_setup() returns — meaning all subscriptions are registered.
        // We take reg.size() times so we know every plugin is fully ready
        // before any data starts flowing.
        printf("[runtime] Waiting for %zu plugins to finish setup...\n",
               reg.size());
        for (size_t i = 0; i < reg.size(); i++) {
            k_sem_take(&stoplight_ready, K_FOREVER);
            printf("[runtime] %zu/%zu plugins ready\n", i + 1, reg.size());
        }

        g_program_start_mtime = read_mtime_runtime();
        printf("[runtime] All %zu plugins ready — data flow begins.\n",
               reg.size());
        printf("[runtime] Timing start: mtime=%llu ticks\n",
               (unsigned long long)g_program_start_mtime);
    }

    void shutdown() {
        printf("[runtime] Shutting down...\n");
    }

private:
    phonebook_new& pb_;
};

} // namespace ILLIXR

#endif // ILLIXR_RUNTIME_HPP
```
